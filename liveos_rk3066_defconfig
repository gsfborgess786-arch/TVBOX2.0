## liveos_rk3066_defconfig
```kconfig
# LiveOS para RK3066 (GameStick / MK808 e parecidos) - Buildroot 2024.08.x
# NAO TESTADO NA PLACA. Revise os avisos do "make liveos_rk3066_defconfig".

# ---- CPU / toolchain
BR2_arm=y
BR2_cortex_a9=y
BR2_ARM_ENABLE_NEON=y
BR2_ARM_ENABLE_VFP=y
BR2_ARM_FPU_NEON_VFPV3=y
BR2_ARM_INSTRUCTIONS_THUMB2=y
BR2_TOOLCHAIN_BUILDROOT_GLIBC=y
BR2_TOOLCHAIN_BUILDROOT_CXX=y
BR2_KERNEL_HEADERS_6_6=y

# ---- cache de compilacao (permite retomar o build)
BR2_CCACHE=y
BR2_CCACHE_DIR="$(HOME)/.buildroot-ccache"
BR2_CCACHE_INITIAL_SETUP="--max-size=6G"

# ---- sistema
BR2_TARGET_GENERIC_HOSTNAME="liveos"
BR2_TARGET_GENERIC_ISSUE="LiveOS"
BR2_TARGET_GENERIC_ROOT_PASSWD="liveos"
BR2_TARGET_TZ_INFO=y
BR2_TARGET_LOCALTIME="America/Sao_Paulo"
BR2_ROOTFS_DEVICE_CREATION_DYNAMIC_EUDEV=y
BR2_ROOTFS_OVERLAY="$(BR2_EXTERNAL_LIVEOS_PATH)/board/liveos/overlay"
BR2_ROOTFS_POST_BUILD_SCRIPT="$(BR2_EXTERNAL_LIVEOS_PATH)/board/liveos/post-build.sh"
BR2_ROOTFS_POST_IMAGE_SCRIPT="$(BR2_EXTERNAL_LIVEOS_PATH)/board/liveos/post-image.sh"

# ---- kernel (DTS do MK808, que tambem e RK3066)
BR2_LINUX_KERNEL=y
BR2_LINUX_KERNEL_CUSTOM_VERSION=y
BR2_LINUX_KERNEL_CUSTOM_VERSION_VALUE="6.6.52"
BR2_LINUX_KERNEL_DEFCONFIG="multi_v7"
BR2_LINUX_KERNEL_CONFIG_FRAGMENT_FILES="$(BR2_EXTERNAL_LIVEOS_PATH)/board/liveos/linux.fragment"
BR2_LINUX_KERNEL_DTS_SUPPORT=y
BR2_LINUX_KERNEL_INTREE_DTS_NAME="rockchip/rk3066a-mk808"
BR2_LINUX_KERNEL_NEEDS_HOST_OPENSSL=y

# ---- U-Boot (placa MK808). O RK3066 NAO inicia pelo SD: TPL+SPL vao na NAND
# (carregador gravado por USB) e o U-Boot completo + kernel ficam no SD.
BR2_TARGET_UBOOT=y
BR2_TARGET_UBOOT_BUILD_SYSTEM_KCONFIG=y
BR2_TARGET_UBOOT_CUSTOM_VERSION=y
BR2_TARGET_UBOOT_CUSTOM_VERSION_VALUE="2024.07"
BR2_TARGET_UBOOT_BOARD_DEFCONFIG="mk808"
BR2_TARGET_UBOOT_NEEDS_DTC=y
BR2_TARGET_UBOOT_NEEDS_PYTHON3=y
BR2_TARGET_UBOOT_NEEDS_PYLIBFDT=y
BR2_TARGET_UBOOT_NEEDS_PYELFTOOLS=y
BR2_TARGET_UBOOT_FORMAT_DTB_IMG=y
BR2_TARGET_UBOOT_SPL=y
BR2_TARGET_UBOOT_SPL_NAME="spl/u-boot-spl.bin"
BR2_TARGET_UBOOT_TPL=y
BR2_TARGET_UBOOT_TPL_NAME="tpl/u-boot-tpl.bin"

# ---- imagem do SD
BR2_TARGET_ROOTFS_EXT4=y
BR2_TARGET_ROOTFS_EXT4_SIZE="1400M"
BR2_PACKAGE_HOST_GENIMAGE=y
BR2_PACKAGE_HOST_DOSFSTOOLS=y
BR2_PACKAGE_HOST_MTOOLS=y

# ---- video: DRM/KMS + GPU Mali-400 (driver Lima) + navegador WPE/Cog em tela cheia
BR2_PACKAGE_MESA3D=y
BR2_PACKAGE_MESA3D_GALLIUM_DRIVER_LIMA=y
BR2_PACKAGE_MESA3D_OPENGL_EGL=y
BR2_PACKAGE_MESA3D_OPENGL_ES=y
BR2_PACKAGE_LIBDRM=y
BR2_PACKAGE_LIBINPUT=y
BR2_PACKAGE_WPEWEBKIT=y
BR2_PACKAGE_WPEWEBKIT_MULTIMEDIA=y
BR2_PACKAGE_COG=y
BR2_PACKAGE_COG_PLATFORM_DRM=y
BR2_PACKAGE_COG_PROGRAMS_HOME_URI="http://127.0.0.1:8080/liveos.html"
BR2_PACKAGE_GST1_PLUGINS_BASE=y
BR2_PACKAGE_GST1_PLUGINS_GOOD=y
BR2_PACKAGE_GST1_PLUGINS_BAD=y
BR2_PACKAGE_GST1_LIBAV=y
BR2_PACKAGE_ALSA_UTILS=y
BR2_PACKAGE_DEJAVU=y
BR2_PACKAGE_LIBERATION=y

# ---- rede / Wi-Fi
BR2_PACKAGE_WPA_SUPPLICANT=y
BR2_PACKAGE_WPA_SUPPLICANT_PASSPHRASE=y
BR2_PACKAGE_WPA_SUPPLICANT_CLI=y
BR2_PACKAGE_IW=y
BR2_PACKAGE_IPROUTE2=y
BR2_PACKAGE_UTIL_LINUX=y
BR2_PACKAGE_UTIL_LINUX_RFKILL=y
BR2_PACKAGE_CA_CERTIFICATES=y
BR2_PACKAGE_GLIB_NETWORKING=y
BR2_PACKAGE_LINUX_FIRMWARE=y
BR2_PACKAGE_LINUX_FIRMWARE_RTL_81XX=y
BR2_PACKAGE_LINUX_FIRMWARE_RTL_88XX=y
BR2_PACKAGE_LINUX_FIRMWARE_ATHEROS_9170=y
BR2_PACKAGE_LINUX_FIRMWARE_MEDIATEK_MT7601U=y
BR2_PACKAGE_LINUX_FIRMWARE_BRCM_BCM43XXX=y

# ---- tecla Home do controle/teclado
BR2_PACKAGE_TRIGGERHAPPY=y
```
